## rpi-build/conf/bblayers.conf
```bitbake
# POKY_BBLAYERS_CONF_VERSION is increased each time build/conf/bblayers.conf
# changes incompatibly
POKY_BBLAYERS_CONF_VERSION = "2"

BBPATH = "${TOPDIR}"
BBFILES ?= ""

BBLAYERS ?= " \
  /home/jabk/projects/privat/yocto/poky/meta \
  /home/jabk/projects/privat/yocto/poky/meta-poky \
  /home/jabk/projects/privat/yocto/poky/meta-yocto-bsp \
  /home/jabk/projects/privat/yocto/meta-openembedded/meta-oe \
  /home/jabk/projects/privat/yocto/meta-openembedded/meta-python \
  /home/jabk/projects/privat/yocto/meta-openembedded/meta-webserver \
  /home/jabk/projects/privat/yocto/meta-widde \
  /home/jabk/projects/privat/yocto/meta-raspberrypi \
  "
```

## rpi-build/conf/distro/rpi-mender.conf
```bitbake
include poky.conf

KERNEL_IMAGETYPE = "uImage"
MENDER_PARTITION_ALIGNMENT_MB = "4"
MENDER_BOOT_PART_SIZE_MB = "40"
MENDER_SERVER_URL = "https://barsoekjaergaard.dk:8999/"

INHERIT += "rm_work mender-uboot mender-image mender-install"

MENDER_ARTIFACT_NAME="bootstrap"
```

## rpi-build/conf/local.conf
```bitbake
MACHINE ??= "raspberrypi2"
DISTRO ?= "poky"
PACKAGE_CLASSES ?= "package_rpm"
IMAGE_PKGTYPE = "rpm"
EXTRA_IMAGE_FEATURES ?= "debug-tweaks"
USER_CLASSES ?= "buildstats image-mklibs image-prelink"
PATCHRESOLVE = "noop"
BB_DISKMON_DIRS = "\
    STOPTASKS,${TMPDIR},1G,100K \
    STOPTASKS,${DL_DIR},1G,100K \
    STOPTASKS,${SSTATE_DIR},1G,100K \
    STOPTASKS,/tmp,100M,100K \
    ABORT,${TMPDIR},100M,1K \
    ABORT,${DL_DIR},100M,1K \
    ABORT,${SSTATE_DIR},100M,1K \
    ABORT,/tmp,10M,1K"


PACKAGECONFIG_append_pn-qemu-native = " sdl"
PACKAGECONFIG_append_pn-nativesdk-qemu = " sdl"
# this doesn't mean anything to you.
CONF_VERSION = "1"

#IMAGE_INSTALL_append = "home-assistant hiawatha rf24 homemonitor s3-bash"
#IMAGE_ROOTFS_EXTRA_SPACE = "128000"
IMAGE_INSTALL_append = "hiawatha python python-paho-mqtt bind-utils"
JABK_IMAGE_INSTALL = "hiawatha python python-paho-mqtt bind-utils"
INHERIT += "rm_work"

#mender things
KERNEL_IMAGETYPE = "uImage"
MENDER_PARTITION_ALIGNMENT_MB = "4"
MENDER_BOOT_PART_SIZE_MB = "40"

# raspberrypi files aligned with mender layout requirements
IMAGE_BOOT_FILES_append = " boot.scr u-boot.bin;${SDIMG_KERNELIMAGE}"
IMAGE_INSTALL_append = " kernel-image kernel-devicetree ${JABK_IMAGE_INSTALL}"
MENDER_ARTIFACT_NAME = "release-1"

INHERIT += "mender-uboot mender-image mender-install"
IMAGE_FSTYPES = "ext4"
SDIMG_ROOTFS_TYPE = "ext4"
MENDER_SERVER_URL = "https://barsoekjaergaard.dk:8999/"
```

## rpi-build/conf/machine/bananapi-m3.conf
```bitbake
#@TYPE: Machine
#@NAME: bananapi-m3-conf
#@DESCRIPTION: Machine configuration for the orange-pi-one, base on allwinner H3 CPU

require conf/machine/include/sun8i.inc

PREFERRED_VERSION_u-boot = "v2017.03%"
PREFERRED_VERSION_linux = "4.13.0+git%"

KERNEL_DEVICETREE = "sun8i-a83t-bananapi-m3.dtb"
UBOOT_MACHINE = "sunxi_defconfig"

DEFAULTTUNE = "cortexa7hf-neon-vfpv4"
```
